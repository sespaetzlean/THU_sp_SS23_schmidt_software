## boards/arm/thu_dk_smart_home_sa_schmidt23/Kconfig.board
```kconfig
# Copyright (c) 2023 Nordic Semiconductor ASA
# SPDX-License-Identifier: Apache-2.0

config BOARD_THU_DK_SMART_HOME_SA_SCHMIDT23
	bool "THU dk smartHome Schmidt23 sa"
	depends on SOC_NRF52832_QFAA
```

## boards/arm/thu_dk_smart_home_sa_schmidt23/Kconfig.defconfig
```kconfig
# Copyright (c) 2023 Nordic Semiconductor ASA
# SPDX-License-Identifier: Apache-2.0

if BOARD_THU_DK_SMART_HOME_SA_SCHMIDT23

config BOARD
	default "thu_dk_smart_home_sa_schmidt23"

config BT_CTLR
   default BT

endif
```

## boards/arm/thu_dk_smart_home_sa_schmidt23/thu_dk_smart_home_sa_schmidt23_defconfig
```kconfig
# Copyright (c) 2023 Nordic Semiconductor ASA
# SPDX-License-Identifier: Apache-2.0

CONFIG_SOC_SERIES_NRF52X=y
CONFIG_SOC_NRF52832_QFAA=y
CONFIG_BOARD_THU_DK_SMART_HOME_SA_SCHMIDT23=y

# Enable MPU
CONFIG_ARM_MPU=y

# Enable hardware stack protection
CONFIG_HW_STACK_PROTECTION=y

#added by me

# additional board options
CONFIG_GPIO_AS_PINRESET=y

CONFIG_PINCTRL=y
```

## boards/arm/thu_proto_v1_0/Kconfig.board
```kconfig
# Copyright (c) 2023 Nordic Semiconductor ASA
# SPDX-License-Identifier: Apache-2.0

config BOARD_THU_PROTO_V1_0
	bool "thu prototype pcb v1_0"
	depends on SOC_NRF52832_QFAA
```

## boards/arm/thu_proto_v1_0/Kconfig.defconfig
```kconfig
# Copyright (c) 2023 Nordic Semiconductor ASA
# SPDX-License-Identifier: Apache-2.0

if BOARD_THU_PROTO_V1_0

config BOARD
	default "thu_proto_v1_0"

config BT_CTLR
   default BT

endif # BOARD_THU_PROTO_V1_0
```

## dk_build/Kconfig/Kconfig.shield
```kconfig
osource "f:/Github/THU_student_project_SS23_schmidt/software/aktor_relais/boards/shields/*/Kconfig.shield"
osource "D:/ncs/v2.3.0/nrf/boards/shields/*/Kconfig.shield"
```

## dk_build/Kconfig/Kconfig.shield.defconfig
```kconfig
osource "f:/Github/THU_student_project_SS23_schmidt/Software/aktor_relais/boards/shields/*/Kconfig.defconfig"
osource "D:/ncs/v2.3.0/nrf/boards/shields/*/Kconfig.defconfig"
```
